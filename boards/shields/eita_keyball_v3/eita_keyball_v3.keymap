#include <behaviors.dtsi>
#include <dt-bindings/zmk/keys.h>

#include <input/processors.dtsi>

&mkp_input_listener {
    input-processors = <&zip_temp_layer 2 250>;
};

#include "../../../config/keymap.keymap"
