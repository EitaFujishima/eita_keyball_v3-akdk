## boards/shields/eita_keyball_v3/Kconfig.defconfig
```kconfig
if SHIELD_EITA_KEYBALL_V3_RIGHT

config ZMK_KEYBOARD_NAME
    default "eita_keyball_v3"

endif

if SHIELD_EITA_KEYBALL_V3_LEFT || SHIELD_EITA_KEYBALL_V3_RIGHT

config ZMK_SPLIT
    default y

endif
```

## boards/shields/eita_keyball_v3/Kconfig.shield
```kconfig
config SHIELD_EITA_KEYBALL_V3_LEFT
    def_bool $(shields_list_contains,eita_keyball_v3_left)
config SHIELD_EITA_KEYBALL_V3_RIGHT
    def_bool $(shields_list_contains,eita_keyball_v3_right)
```
